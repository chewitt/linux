## Documentation/devicetree/bindings/sound/amlogic,gxbb-audin.yaml
```yaml
# SPDX-License-Identifier: (GPL-2.0-only OR BSD-2-Clause)
%YAML 1.2
---
$id: http://devicetree.org/schemas/sound/amlogic,gxbb-audin.yaml#
$schema: http://devicetree.org/meta-schemas/core.yaml#

title: Amlogic GXBB AUDIN audio input controller

maintainers:
  - Valerio Setti <vsetti@baylibre.com>

description:
  AUDIN is the audio input block of the Amlogic GXBB/GXL SoCs. It supports
  various input formatters (I2S, SPDIF, PCM, HDMI) feeding three FIFOs that
  transfer captured samples to memory. The sound-dai cell selects the FIFO.

allOf:
  - $ref: dai-common.yaml#

properties:
  compatible:
    oneOf:
      - const: amlogic,gxbb-audin
      - items:
          - const: amlogic,gxl-audin
          - const: amlogic,gxbb-audin

  reg:
    maxItems: 1

  resets:
    maxItems: 1

  interrupts:
    maxItems: 1

  clocks:
    items:
      - description: AUDIN peripheral clock

  "#sound-dai-cells":
    const: 1

required:
  - compatible
  - reg
  - resets
  - interrupts
  - clocks
  - "#sound-dai-cells"

unevaluatedProperties: false

examples:
  - |
    #include <dt-bindings/clock/gxbb-clkc.h>
    #include <dt-bindings/interrupt-controller/arm-gic.h>
    #include <dt-bindings/interrupt-controller/irq.h>
    #include <dt-bindings/reset/amlogic,meson-gxbb-reset.h>

    audio-controller@a000 {
      compatible = "amlogic,gxbb-audin";
      reg = <0xa000 0x148>;
      resets = <&reset RESET_AUDIN>;
      interrupts = <GIC_SPI 7 IRQ_TYPE_EDGE_RISING>;
      sound-name-prefix = "AUDIN";
      #sound-dai-cells = <1>;
      clocks = <&clkc CLKID_I2S_SPDIF>;
    };
```

## Documentation/devicetree/bindings/sound/amlogic,meson-gx-audin-fifo.yaml
```yaml
# SPDX-License-Identifier: (GPL-2.0-only OR BSD-2-Clause)
%YAML 1.2
---
$id: http://devicetree.org/schemas/sound/amlogic,meson-gx-audin-fifo.yaml#
$schema: http://devicetree.org/meta-schemas/core.yaml#

title: Amlogic GX AUDIN FIFO controller

maintainers:
  - Valerio Setti <vsetti@baylibre.com>

description: |-
  AUDIN FIFO receives audio data from backend interfaces (ex: I2S, SPDIF),
  stores them into a FIFO in a configurable way and then bulk copies all the
  data in RAM when the FIFO is full.

allOf:
  - $ref: dai-common.yaml#

properties:
  $nodename:
    pattern: "^audio-controller@[0-9a-f]+$"

  compatible:
    items:
      - enum:
          - amlogic,meson-gxbb-audin-fifo
          - amlogic,meson-gxl-audin-fifo
      - const: amlogic,meson-gx-audin-fifo

  reg:
    maxItems: 1

  "#sound-dai-cells":
    const: 0

required:
  - compatible
  - reg
  - "#sound-dai-cells"

unevaluatedProperties: false

examples:
  - |
    audio-controller@80 {
      compatible = "amlogic,meson-gxbb-audin-fifo",
                   "amlogic,meson-gx-audin-fifo";
      reg = <0x80 0x1c>;
      #sound-dai-cells = <0>;
      sound-name-prefix = "AUDIN FIFO0";
    };
```

## Documentation/devicetree/bindings/sound/amlogic,meson-gx-audin.yaml
```yaml
# SPDX-License-Identifier: (GPL-2.0-only OR BSD-2-Clause)
%YAML 1.2
---
$id: http://devicetree.org/schemas/sound/amlogic,meson-gx-audin.yaml#
$schema: http://devicetree.org/meta-schemas/core.yaml#

title: Amlogic GX AUDIN

maintainers:
  - Valerio Setti <vsetti@baylibre.com>

description: |-
  AUDIN provides audio input support for the Amlogic GX based platforms
  (GXBB/GXL). DT-wise it acts as parent node for FIFO child nodes, whereas
  from sound subsystem point of view it is a component providing data
  formatting widgets.
  Supported audio formats are: I2S, SPDIF and PCM.

allOf:
  - $ref: component-common.yaml#

properties:
  $nodename:
    pattern: "^audio-controller@[0-9a-f]+$"

  compatible:
    items:
      - enum:
          - amlogic,meson-gxbb-audin
          - amlogic,meson-gxl-audin
      - const: amlogic,meson-gx-audin

  reg:
    maxItems: 1

  "#address-cells":
    const: 1

  "#size-cells":
    const: 1

  ranges: true

  resets:
    maxItems: 1

  interrupts:
    maxItems: 1

  clocks:
    items:
      - description: AUDIN peripheral clock

patternProperties:
  "^audio-controller@[0-9a-f]+$":
    type: object
    $ref: amlogic,meson-gx-audin-fifo.yaml#

required:
  - compatible
  - reg
  - "#address-cells"
  - "#size-cells"
  - resets
  - interrupts
  - ranges
  - clocks

unevaluatedProperties: false

examples:
  - |
    #include <dt-bindings/clock/gxbb-clkc.h>
    #include <dt-bindings/interrupt-controller/arm-gic.h>
    #include <dt-bindings/interrupt-controller/irq.h>
    #include <dt-bindings/reset/amlogic,meson-gxbb-reset.h>

    audio-controller@a000 {
      compatible = "amlogic,meson-gxbb-audin", "amlogic,meson-gx-audin";
      reg = <0xa000 0x308>;
      #address-cells = <1>;
      #size-cells = <1>;
      ranges = <0x0 0xa000 0x308>;
      resets = <&reset RESET_AUDIN>;
      interrupts = <GIC_SPI 7 IRQ_TYPE_EDGE_RISING>;
      sound-name-prefix = "AUDIN";
      clocks = <&clkc CLKID_I2S_SPDIF>;

      audio-controller@80 {
        compatible = "amlogic,meson-gxbb-audin-fifo",
                     "amlogic,meson-gx-audin-fifo";
        reg = <0x80 0x1c>;
        #sound-dai-cells = <0>;
        sound-name-prefix = "AUDIN FIFO0";
      };
    };
```

## drivers/media/platform/amlogic/amvdec/Kconfig
```kconfig
# SPDX-License-Identifier: GPL-2.0

config VIDEO_MESON_AMVDEC
	tristate "Amlogic video decoder driver"
	depends on V4L_MEM2MEM_DRIVERS
	depends on VIDEO_DEV && HAS_DMA
	select MEDIA_CONTROLLER
	depends on ARCH_MESON || COMPILE_TEST
	select VIDEOBUF2_DMA_CONTIG
	select V4L2_MEM2MEM_DEV
	select V4L2_H264
	select MESON_CANVAS
	help
	Support for the video decoder found in the Amlogic GXBB, GXL, GXM,
	G12A, G12B and SM1 SoCs: stateless H.264, HEVC, MPEG-2 and VP9
	decoding through the V4L2 request API.

	To compile this driver as a module, choose M here: the module will
	be called meson-amvdec.
```

## drivers/media/platform/amlogic/meson-demux/Kconfig
```kconfig
config DVB_MESON
	tristate "Amlogic DVB demux driver"
	depends on ARCH_MESON || COMPILE_TEST
	select DVB_CXD2841ER if MEDIA_SUBDRV_AUTOSELECT
	select DVB_MN88436 if MEDIA_SUBDRV_AUTOSELECT
	select DVB_AVL6211 if MEDIA_SUBDRV_AUTOSELECT
	select DVB_ASCOT3 if MEDIA_SUBDRV_AUTOSELECT
	select MEDIA_TUNER_MXL603 if MEDIA_SUBDRV_AUTOSELECT
	help
	  This is a DVB demux driver for Amlogic.
```

## drivers/media/platform/amlogic/meson-di/Kconfig
```kconfig
# SPDX-License-Identifier: GPL-2.0-only

config VIDEO_MESON_DI
	tristate "Amlogic video deinterlacer"
	depends on V4L_MEM2MEM_DRIVERS
	depends on VIDEO_DEV
	depends on ARCH_MESON || COMPILE_TEST
	depends on MESON_CANVAS
	select MFD_SYSCON
	select VIDEOBUF2_DMA_CONTIG
	select V4L2_MEM2MEM_DEV
	help
	  Support for the video deinterlacer (DI) of the Amlogic G12A, G12B
	  and SM1 SoCs as a V4L2 memory-to-memory device.

	  To compile this driver as a module, choose M here: the module will
	  be called meson-di.
```

## drivers/media/platform/rockchip/iep/Kconfig
```kconfig
# SPDX-License-Identifier: GPL-2.0-only

config VIDEO_ROCKCHIP_IEP_COMMON
	tristate

config VIDEO_ROCKCHIP_IEP
	tristate "Rockchip Image Enhancement Processor"
	depends on V4L_MEM2MEM_DRIVERS
	depends on VIDEO_DEV
	depends on ARCH_ROCKCHIP || COMPILE_TEST
	select VIDEOBUF2_DMA_CONTIG
	select V4L2_MEM2MEM_DEV
	select VIDEO_ROCKCHIP_IEP_COMMON
	help
	  Support for the Rockchip IEP, a hardware video deinterlacer
	  with spatial and temporal sampling noise reduction. Found
	  on RK3288, RK3328, RK3399 and similar SoCs.

	  To compile this driver as a module, choose M here: the module
	  will be called rockchip-iep.

config VIDEO_ROCKCHIP_IEP2
	tristate "Rockchip Image Enhancement Processor v2"
	depends on V4L_MEM2MEM_DRIVERS
	depends on VIDEO_DEV
	depends on ARCH_ROCKCHIP || COMPILE_TEST
	select VIDEOBUF2_DMA_CONTIG
	select V4L2_MEM2MEM_DEV
	select VIDEO_ROCKCHIP_IEP_COMMON
	help
	  Support for the Rockchip IEP2, a hardware video deinterlacer
	  with motion detection, motion estimation, and edge-directed
	  interpolation. Found on RK3568, RK3576, RK3588 and similar SoCs.

	  To compile this driver as a module, choose M here: the module
	  will be called rockchip-iep2.
```

## drivers/net/wireless/aic/Kconfig
```kconfig
# SPDX-License-Identifier: GPL-2.0-only

config WLAN_VENDOR_AIC
	bool "AIC devices"
	default y
	help
	  Say Y to expose the AIC8800D80 U02 SDIO Wi-Fi driver.
	  The first upstreaming target is a narrow D80 U02 SDIO station
	  configuration; legacy transport, Bluetooth, Android, test and
	  manufacturing build switches are intentionally not exposed.

if WLAN_VENDOR_AIC

menuconfig AIC8800_BSP_SUPPORT
	tristate "AIC8800D80 U02 SDIO bus support"
	depends on MMC
	select CRYPTO_LIB_MD5
	help
	  Enable the AIC8800D80 U02 SDIO bus support package. It provides
	  the SDIO transport, chip operations and firmware download path used
	  by the AIC8800 FullMAC WLAN driver.

	  Firmware files are loaded from the aic8800/ subdirectory of the
	  kernel firmware search path, normally /lib/firmware/aic8800/.

	  If unsure, say N.

if AIC8800_BSP_SUPPORT

config AIC8800_SDIO_SUPPORT
	def_bool y

config AIC8800_SDIO_PWRCTRL
	def_bool y

source "drivers/net/wireless/aic/aic8800_bsp/Kconfig"
source "drivers/net/wireless/aic/aic8800_fdrv/Kconfig"

endif # AIC8800_BSP_SUPPORT
endif # WLAN_VENDOR_AIC
```

## drivers/net/wireless/aic/aic8800_fdrv/Kconfig
```kconfig
# SPDX-License-Identifier: GPL-2.0-only

menuconfig AIC8800_WLAN_SUPPORT
	tristate "AIC8800D80 U02 SDIO station support"
	depends on AIC8800_BSP_SUPPORT
	depends on CFG80211
	help
	  Enable the AIC8800D80 U02 FullMAC Wi-Fi driver for the first
	  upstreaming baseline. This build is restricted to the SDIO station
	  path and uses cfg80211/nl80211 for normal Wi-Fi operation.

	  If unsure, say N.

if AIC8800_WLAN_SUPPORT

config RWNX_FULLMAC
	def_bool y

config AIC8800_STA_ONLY
	def_bool y
	help
	  Limit the initial upstream driver to station mode. The AP, P2P,
	  monitor, mesh and TDLS implementations remain in the source tree
	  so they can be enabled when those modes are ready for upstream.

config AIC8800_NONSTA_SUPPORT
	def_bool y if !AIC8800_STA_ONLY

config AIC8800_GENL
	bool "AIC8800 private generic netlink interface"
	help
	  Enable the private generic netlink command interface used by
	  vendor tools.

	  If unsure, say N.

endif # AIC8800_WLAN_SUPPORT
```
