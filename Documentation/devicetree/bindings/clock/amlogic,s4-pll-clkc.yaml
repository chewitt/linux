## Documentation/devicetree/bindings/clock/amlogic,s4-pll-clkc.yaml
```yaml
# SPDX-License-Identifier: (GPL-2.0-only OR BSD-2-Clause)
# Copyright (C) 2022-2023 Amlogic, Inc. All rights reserved
%YAML 1.2
---
$id: http://devicetree.org/schemas/clock/amlogic,s4-pll-clkc.yaml#
$schema: http://devicetree.org/meta-schemas/core.yaml#

title: Amlogic S4 PLL Clock Controller

maintainers:
  - Yu Tu <yu.tu@amlogic.com>

properties:
  compatible:
    const: amlogic,s4-pll-clkc

  reg:
    maxItems: 1

  clocks:
    maxItems: 1

  clock-names:
    items:
      - const: xtal

  "#clock-cells":
    const: 1

  amlogic,secure-monitor:
    $ref: /schemas/types.yaml#/definitions/phandle
    description:
      Phandle to the secure monitor. The sys_pll and CPU clock registers
      can only be written by the secure firmware, so the CPU clocks are
      only provided when this property is present.

required:
  - compatible
  - reg
  - clocks
  - clock-names
  - "#clock-cells"

additionalProperties: false

examples:
  - |
    clkc_pll: clock-controller@fe008000 {
      compatible = "amlogic,s4-pll-clkc";
      reg = <0xfe008000 0x1e8>;
      clocks = <&xtal>;
      clock-names = "xtal";
      #clock-cells = <1>;
      amlogic,secure-monitor = <&sm>;
    };

...
```

## Documentation/devicetree/bindings/media/amlogic,g12a-di.yaml
```yaml
# SPDX-License-Identifier: (GPL-2.0-only OR BSD-2-Clause)
%YAML 1.2
---
$id: http://devicetree.org/schemas/media/amlogic,g12a-di.yaml#
$schema: http://devicetree.org/meta-schemas/core.yaml#

title: Amlogic G12A/G12B/SM1 video deinterlacer

maintainers:
  - Christian Hewitt <christianshewitt@gmail.com>

description:
  The video deinterlacer (DI) of the Amlogic G12A, G12B and SM1 SoCs reads
  interlaced frames from memory and writes progressive frames back to
  memory. Its registers are part of the VPU register space.

properties:
  compatible:
    enum:
      - amlogic,g12a-di
      - amlogic,g12b-di
      - amlogic,sm1-di

  reg:
    maxItems: 1

  interrupts:
    items:
      - description: pre-processing done
      - description: post-processing done

  interrupt-names:
    items:
      - const: pre
      - const: post

  clocks:
    items:
      - description: deinterlacer core clock
      - description: VPU interrupt clock

  clock-names:
    items:
      - const: vpu_clkb
      - const: vpu_intr

  power-domains:
    maxItems: 1

  amlogic,canvas:
    $ref: /schemas/types.yaml#/definitions/phandle
    description: phandle to the canvas provider node

  amlogic,hhi-sysctrl:
    $ref: /schemas/types.yaml#/definitions/phandle
    description: phandle to the HHI system controller

required:
  - compatible
  - reg
  - interrupts
  - interrupt-names
  - clocks
  - clock-names
  - power-domains
  - amlogic,canvas
  - amlogic,hhi-sysctrl

additionalProperties: false

examples:
  - |
    #include <dt-bindings/clock/g12a-clkc.h>
    #include <dt-bindings/interrupt-controller/arm-gic.h>
    #include <dt-bindings/power/meson-g12a-power.h>

    soc {
        #address-cells = <2>;
        #size-cells = <2>;

        video-deinterlacer@ff905c00 {
            compatible = "amlogic,g12a-di";
            reg = <0x0 0xff905c00 0x0 0x8400>;
            interrupts = <GIC_SPI 46 IRQ_TYPE_EDGE_RISING>,
                         <GIC_SPI 40 IRQ_TYPE_EDGE_RISING>;
            interrupt-names = "pre", "post";
            clocks = <&clkc CLKID_VPU_CLKB>,
                     <&clkc CLKID_VPU_INTR>;
            clock-names = "vpu_clkb", "vpu_intr";
            power-domains = <&pwrc PWRC_G12A_VPU_ID>;
            amlogic,canvas = <&canvas>;
            amlogic,hhi-sysctrl = <&hhi>;
        };
    };
```

## Documentation/devicetree/bindings/media/amlogic,gx-di.yaml
```yaml
# SPDX-License-Identifier: (GPL-2.0 OR BSD-2-Clause)
%YAML 1.2
---
$id: http://devicetree.org/schemas/media/amlogic,gx-di.yaml#
$schema: http://devicetree.org/meta-schemas/core.yaml#

title: Amlogic GX Video Deinterlacer

maintainers:
  - Christian Hewitt <christianshewitt@gmail.com>

description: |
  The deinterlacer (DI) is a motion-adaptive hardware deinterlacing unit
  found on the Amlogic GXBB, GXL and GXM SoCs. It converts interlaced video
  fields into progressive frames using a two-stage pipeline: a "pre" stage
  performs noise reduction and per-pixel motion detection, writing motion
  information to memory, and a "post" stage blends the fields using that
  motion information.

  The DI registers are a sub-region of the shared VPU register space (VCBUS).
  Clocking, power and the video reset lines are provided through the VPU power
  domain; the DI block gates and resets itself using registers within its own
  region.

properties:
  compatible:
    items:
      - enum:
          - amlogic,gxbb-di # GXBB (S905)
          - amlogic,gxl-di # GXL (S905D, S905W, S905X, S905Y)
          - amlogic,gxm-di # GXM (S912)
      - const: amlogic,gx-di

  reg:
    maxItems: 1

  interrupts:
    items:
      - description: deinterlacer pre-stage completion interrupt
      - description: deinterlacer post-stage completion interrupt

  interrupt-names:
    items:
      - const: de
      - const: timerc

  power-domains:
    maxItems: 1

  amlogic,canvas:
    description: should point to a canvas provider node
    $ref: /schemas/types.yaml#/definitions/phandle

required:
  - compatible
  - reg
  - interrupts
  - interrupt-names
  - power-domains
  - amlogic,canvas

additionalProperties: false

examples:
  - |
    #include <dt-bindings/interrupt-controller/arm-gic.h>
    #include <dt-bindings/power/meson-gxbb-power.h>

    deinterlace@d0105c00 {
          compatible = "amlogic,gxl-di", "amlogic,gx-di";
          reg = <0xd0105c00 0x8800>;
          interrupts = <GIC_SPI 46 IRQ_TYPE_EDGE_RISING>,
                       <GIC_SPI 6 IRQ_TYPE_EDGE_RISING>;
          interrupt-names = "de", "timerc";
          power-domains = <&pwrc PWRC_GXBB_VPU_ID>;
          amlogic,canvas = <&canvas>;
    };
```

## Documentation/devicetree/bindings/media/amlogic,gx-vdec.yaml
```yaml
# SPDX-License-Identifier: (GPL-2.0 OR BSD-2-Clause)
# Copyright 2019 BayLibre, SAS
%YAML 1.2
---
$id: http://devicetree.org/schemas/media/amlogic,gx-vdec.yaml#
$schema: http://devicetree.org/meta-schemas/core.yaml#

title: Amlogic Video Decoder

maintainers:
  - Neil Armstrong <neil.armstrong@linaro.org>
  - Christian Hewitt <christianshewitt@gmail.com>
  - Gus Bourg <gus@bourg.net>

description: |
  The video decoding IP lies within the DOS memory region,
  except for the hardware bitstream parser that makes use of an undocumented
  region.

  It makes use of the following blocks:
  - ESPARSER is a bitstream parser that outputs to a VIFIFO. Further VDEC blocks
    then feed from this VIFIFO.
  - VDEC_1 can decode MPEG-1, MPEG-2, MPEG-4 part 2, MJPEG, H.263, H.264, VC-1.
  - VDEC_HEVC can decode HEVC, and VP9 on GXL, GXM, G12A and SM1.

  Both VDEC_1 and VDEC_HEVC share the "vdec" IRQ and as such cannot run
  concurrently.

  S4 has no ESPARSER: the decoder fetches the bitstream from memory directly,
  and the VDEC_1 and VDEC_HEVC power domains are switched by the secure
  monitor.

properties:
  compatible:
    oneOf:
      - items:
          - enum:
              - amlogic,gxbb-vdec # GXBB (S905)
              - amlogic,gxl-vdec # GXL (S905D, S905W, S905X, S905Y)
              - amlogic,gxlx-vdec # GXLX (S905L)
              - amlogic,gxm-vdec # GXM (S912)
          - const: amlogic,gx-vdec
      - enum:
          - amlogic,g12a-vdec # G12A (S905X2, S905D2)
          - amlogic,sm1-vdec # SM1 (S905X3, S905D3)
          - amlogic,s4-vdec # S4 (S805X2, S905Y4)

  interrupts:
    minItems: 1
    maxItems: 2

  interrupt-names:
    minItems: 1
    items:
      - const: vdec
      - const: esparser

  reg:
    maxItems: 2

  reg-names:
    items:
      - const: dos
      - enum: [ esparser, dmc ]

  resets:
    minItems: 1
    maxItems: 3

  reset-names:
    minItems: 1
    maxItems: 3

  clocks:
    minItems: 3
    maxItems: 5

  clock-names:
    minItems: 3
    maxItems: 5

  power-domains:
    maxItems: 2

  power-domain-names:
    items:
      - const: vdec
      - const: hevc

  amlogic,ao-sysctrl:
    description: should point to the AOBUS sysctrl node
    $ref: /schemas/types.yaml#/definitions/phandle

  amlogic,canvas:
    description: should point to a canvas provider node
    $ref: /schemas/types.yaml#/definitions/phandle

allOf:
  - if:
      properties:
        compatible:
          contains:
            enum:
              - amlogic,gx-vdec

    then:
      properties:
        clock-names:
          items:
            - const: dos_parser
            - const: dos
            - const: vdec_1
            - const: vdec_hevc

  - if:
      properties:
        compatible:
          contains:
            enum:
              - amlogic,g12a-vdec
              - amlogic,sm1-vdec

    then:
      properties:
        clock-names:
          items:
            - const: dos_parser
            - const: dos
            - const: vdec_1
            - const: vdec_hevc
            - const: vdec_hevcf

  - if:
      properties:
        compatible:
          contains:
            const: amlogic,s4-vdec

    then:
      properties:
        interrupts:
          maxItems: 1
        reg-names:
          items:
            - const: dos
            - const: dmc
        clock-names:
          items:
            - const: dos
            - const: vdec_1
            - const: vdec_hevc
        resets:
          items:
            - description: HEVC front pipeline 0
            - description: HEVC front pipeline 1
            - description: HEVC back pipeline 1
        reset-names:
          items:
            - const: hevcf-pipl0
            - const: hevcf-pipl1
            - const: hevcb-pipl1
        amlogic,ao-sysctrl: false
      required:
        - power-domains
        - power-domain-names

    else:
      properties:
        interrupts:
          minItems: 2
        reg:
          minItems: 2
        reg-names:
          items:
            - const: dos
            - const: esparser
        resets:
          maxItems: 1
        reset-names:
          items:
            - const: esparser
        power-domains: false
        power-domain-names: false
      required:
        - resets
        - reset-names
        - amlogic,ao-sysctrl

required:
  - compatible
  - reg
  - reg-names
  - interrupts
  - interrupt-names
  - clocks
  - clock-names
  - amlogic,canvas

additionalProperties: false

examples:
  - |
    vdec: video-decoder@c8820000 {
          compatible = "amlogic,gxl-vdec", "amlogic,gx-vdec";
          reg = <0xc8820000 0x10000>, <0xc110a580 0xe4>;
          reg-names = "dos", "esparser";
          interrupts = <44>, <32>;
          interrupt-names = "vdec", "esparser";
          clocks = <&clk_dos_parser> ,<&clk_dos>, <&clk_vdec_1>, <&clk_vdec_hevc>;
          clock-names = "dos_parser", "dos", "vdec_1", "vdec_hevc";
          resets = <&reset_parser>;
          reset-names = "esparser";
          amlogic,ao-sysctrl = <&sysctrl_AO>;
          amlogic,canvas = <&canvas>;
    };
```

## Documentation/devicetree/bindings/opp/amlogic,s4-cpu-operating-points.yaml
```yaml
# SPDX-License-Identifier: (GPL-2.0-only OR BSD-2-Clause)
%YAML 1.2
---
$id: http://devicetree.org/schemas/opp/amlogic,s4-cpu-operating-points.yaml#
$schema: http://devicetree.org/meta-schemas/core.yaml#

title: Amlogic S4 CPU OPP

maintainers:
  - Christian Hewitt <christianshewitt@gmail.com>

description: |
  Amlogic S4 SoCs are binned at manufacture, and the CPU voltage for each
  OPP depends on the bin. The secure monitor firmware reports the bin,
  where a higher bin is better silicon that runs the same frequency at a
  lower voltage. Each OPP lists the voltage for a bin in
  opp-microvolt-bin<N>, and falls back to opp-microvolt for bins it does
  not list.

allOf:
  - $ref: opp-v2-base.yaml#

properties:
  compatible:
    const: amlogic,s4-cpu-operating-points

  amlogic,secure-monitor:
    description: phandle to the secure monitor that reports the bin
    $ref: /schemas/types.yaml#/definitions/phandle-array
    items:
      - items:
          - description: phandle to the secure monitor

  opp-shared: true

required:
  - compatible
  - amlogic,secure-monitor

patternProperties:
  "^opp-[0-9]+$":
    type: object

    properties:
      opp-hz: true
      clock-latency-ns: true
      opp-microvolt: true

    patternProperties:
      "^opp-microvolt-bin[0-9]$": true

    required:
      - opp-hz
      - opp-microvolt

    unevaluatedProperties: false

additionalProperties: false

examples:
  - |
    opp-table {
        compatible = "amlogic,s4-cpu-operating-points";
        amlogic,secure-monitor = <&sm>;
        opp-shared;

        opp-100000000 {
            opp-hz = /bits/ 64 <100000000>;
            opp-microvolt = <769000>;
            opp-microvolt-bin2 = <759000>;
            opp-microvolt-bin3 = <759000>;
        };

        opp-1704000000 {
            opp-hz = /bits/ 64 <1704000000>;
            opp-microvolt = <909000>;
            opp-microvolt-bin2 = <829000>;
            opp-microvolt-bin3 = <809000>;
        };
    };
```

## Documentation/devicetree/bindings/sound/amlogic,gx-audin.yaml
```yaml
# SPDX-License-Identifier: (GPL-2.0-only OR BSD-2-Clause)
%YAML 1.2
---
$id: http://devicetree.org/schemas/sound/amlogic,gx-audin.yaml#
$schema: http://devicetree.org/meta-schemas/core.yaml#

title: Amlogic GX AUDIN

maintainers:
  - Valerio Setti <vsetti@baylibre.com>

description:
  AUDIN is the audio input block of the Amlogic GXBB/GXL SoCs. It supports
  various input formatters (I2S, SPDIF, PCM, HDMI) feeding three FIFOs that
  transfer captured samples to memory. The sound-dai cell selects the FIFO.

allOf:
  - $ref: dai-common.yaml#

properties:
  compatible:
    items:
      - enum:
          - amlogic,gxbb-audin
          - amlogic,gxl-audin
      - const: amlogic,gx-audin

  reg:
    maxItems: 1

  resets:
    maxItems: 1

  interrupts:
    maxItems: 1

  clocks:
    items:
      - description: AUDIN peripheral clock

  "#sound-dai-cells":
    const: 1

required:
  - compatible
  - reg
  - resets
  - interrupts
  - clocks
  - "#sound-dai-cells"

unevaluatedProperties: false

examples:
  - |
    #include <dt-bindings/clock/gxbb-clkc.h>
    #include <dt-bindings/interrupt-controller/arm-gic.h>
    #include <dt-bindings/interrupt-controller/irq.h>
    #include <dt-bindings/reset/amlogic,meson-gxbb-reset.h>

    audio-controller@a000 {
      compatible = "amlogic,gxbb-audin", "amlogic,gx-audin";
      reg = <0xa000 0x148>;
      resets = <&reset RESET_AUDIN>;
      interrupts = <GIC_SPI 7 IRQ_TYPE_EDGE_RISING>;
      sound-name-prefix = "AUDIN";
      #sound-dai-cells = <1>;
      clocks = <&clkc CLKID_I2S_SPDIF>;
    };
```
