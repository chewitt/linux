## Documentation/devicetree/bindings/auxdisplay/titanmec,tm16xx.yaml
```yaml
# SPDX-License-Identifier: (GPL-2.0-only OR BSD-2-Clause)
%YAML 1.2
---
$id: http://devicetree.org/schemas/auxdisplay/titanmec,tm16xx.yaml#
$schema: http://devicetree.org/meta-schemas/core.yaml#

title: Auxiliary displays based on TM16xx and compatible LED controllers

maintainers:
  - Jean-François Lessard <jefflessard3@gmail.com>

description: |
  TM16xx controllers manage a matrix of LEDs organized in grids (rows) and segments (columns).
  Each grid or segment can be wired to drive either a digit or individual icons, depending on the
  board design.

  Typical display example:

           ---    ---       ---    ---
    WIFI  |   |  |   |  -  |   |  |   |  USB  PLAY
           ---    ---       ---    ---
    LAN   |   |  |   |  -  |   |  |   |  BT   PAUSE
           ---    ---       ---    ---

  The controller itself is agnostic of the display layout. The specific arrangement
  (which grids and segments drive which digits or icons) is determined by the board-level
  wiring. Therefore, these bindings describe hardware configuration at the PCB level
  to enable support of multiple display implementations using these LED controllers.

properties:
  compatible:
    enum:
      - titanmec,tm1618
      - titanmec,tm1620
      - titanmec,tm1628
      - titanmec,tm1650
      - fdhisi,fd620
      - fdhisi,fd628
      - fdhisi,fd650
      - fdhisi,fd6551
      - fdhisi,fd655
      - icore,aip650
      - icore,aip1618
      - icore,aip1628
      - princeton,pt6964
      - winrise,hbs658

  reg:
    maxItems: 1

  titanmec,digits:
    description: |
      Array of grid (row) indexes corresponding to specific wiring of digits in the display matrix.
      Defines which grid lines are connected to digit elements.
    $ref: /schemas/types.yaml#/definitions/uint8-array
    items:
      minimum: 0
      maximum: 7
    minItems: 1
    maxItems: 8

  titanmec,segment-mapping:
    description: |
      Array of segment (column) indexes specifying the hardware layout mapping used for digit display.
      Each entry gives the segment index corresponding to a standard 7-segment element (a-g).
    $ref: /schemas/types.yaml#/definitions/uint8-array
    items:
      minimum: 0
      maximum: 7
    minItems: 7
    maxItems: 7

  titanmec,transposed:
    description: |
      Optional flag indicating if grids and segments are swapped compared to standard matrix orientation.
      This accommodates devices where segments are wired to rows and grids to columns.
    $ref: /schemas/types.yaml#/definitions/flag

  "#address-cells":
    const: 2

  "#size-cells":
    const: 0

patternProperties:
  "^led@[0-7],[0-7]$":
    $ref: /schemas/leds/common.yaml#
    properties:
      reg:
        description: Grid (row) and segment (column) index in the matrix of this individual LED icon
    required:
      - reg

required:
  - compatible
  - reg
  - titanmec,digits
  - titanmec,segment-mapping

additionalProperties: true

examples:
  - |
    #include <dt-bindings/leds/common.h>

    i2c {
      #address-cells = <1>;
      #size-cells = <0>;

      display-controller@24 {
        reg = <0x24>;
        compatible = "fdhisi,fd655";
        titanmec,digits = [01 02 03 04];
        titanmec,segment-mapping = [03 04 05 00 01 02 06];
        #address-cells = <2>;
        #size-cells = <0>;

        led@0,0 {
          reg = <0 0>;
          function = LED_FUNCTION_ALARM;
        };

        led@0,1 {
          reg = <0 1>;
          function = LED_FUNCTION_USB;
        };

        led@0,2 {
          reg = <0 2>;
          function = "play";
        };

        led@0,3 {
          reg = <0 3>;
          function = "pause";
        };

        led@0,4 {
          reg = <0 4>;
          function = "colon";
        };

        led@0,5 {
          reg = <0 5>;
          function = LED_FUNCTION_LAN;
        };

        led@0,6 {
          reg = <0 6>;
          function = LED_FUNCTION_WLAN;
        };
      };
    };

  - |
    #include <dt-bindings/leds/common.h>

    spi {
      #address-cells = <1>;
      #size-cells = <0>;

      display-controller@0 {
        reg = <0x0>;
        compatible = "fdhisi,fd628";
        titanmec,transposed;
        titanmec,digits = [00 01 02 03];
        titanmec,segment-mapping = [00 01 02 03 04 05 06];
        spi-3wire;
        spi-lsb-first;
        spi-rx-delay-us = <1>;
        spi-max-frequency = <500000>;
        #address-cells = <2>;
        #size-cells = <0>;

        led@4,0 {
          reg = <4 0>;
          function = "apps";
        };

        led@4,1 {
          reg = <4 1>;
          function = "setup";
        };

        led@4,2 {
          reg = <4 2>;
          function = LED_FUNCTION_USB;
        };

        led@4,3 {
          reg = <4 3>;
          function = LED_FUNCTION_SD;
        };

        led@4,4 {
          reg = <4 4>;
          function = "colon";
        };

        led@4,5 {
          reg = <4 5>;
          function = "hdmi";
        };

        led@4,6 {
          reg = <4 6>;
          function = "video";
        };
      };
    };
```

## Documentation/devicetree/bindings/auxdisplay/tm16xx.yaml
```yaml
# SPDX-License-Identifier: (GPL-2.0-only OR BSD-2-Clause)
%YAML 1.2
---
$id: http://devicetree.org/schemas/auxdisplay/tm16xx.yaml#
$schema: http://devicetree.org/meta-schemas/core.yaml#

title: TM16XX and Compatible Auxiliary Display Driver

maintainers:
  - Jean-François Lessard <jefflessard3@gmail.com>

description: |
  Bindings for auxiliary displays based on TM16XX and compatible LED controllers.

properties:
  compatible:
    enum:
      - titanmec,tm1618
      - titanmec,tm1620
      - titanmec,tm1628
      - titanmec,tm1650
      - fdhisi,fd620
      - fdhisi,fd628
      - fdhisi,fd650
      - fdhisi,fd6551
      - fdhisi,fd655
      - princeton,pt6964
      - hbs,hbs658

  reg:
    maxItems: 1

  tm16xx,digits:
    description: Array of grid indexes for each digit
    $ref: /schemas/types.yaml#/definitions/uint8-array
    items:
      minimum: 0
      maximum: 7
    minItems: 1
    maxItems: 8

  tm16xx,segment-mapping:
    description: Array specifying segment mapping (must be exactly 7 elements)
    $ref: /schemas/types.yaml#/definitions/uint8-array
    items:
      minimum: 0
      maximum: 7
    minItems: 7
    maxItems: 7

  tm16xx,transposed:
    description: |
      Optional boolean flag indicating if the device output is transposed.
      If not present, the default value is false.
    $ref: /schemas/types.yaml#/definitions/flag

  "#address-cells":
    const: 2

  "#size-cells":
    const: 0

patternProperties:
  "^led@[0-7],[0-7]$":
    $ref: /schemas/leds/common.yaml#
    properties:
      reg:
        description: Grid and segment indexes
    required:
      - reg

required:
  - compatible
  - reg
  - tm16xx,digits
  - tm16xx,segment-mapping

additionalProperties: true

examples:
  - |
    display_client: i2c {
        #address-cells = <1>;
        #size-cells = <0>;

        display@24 {
            compatible = "titanmec,tm1650";
            reg = <0x24>;
            tm16xx,digits = /bits/ 8 <0 1 2 3>;
            tm16xx,segment-mapping = /bits/ 8 <0 1 2 3 4 5 6>;

            #address-cells = <2>;
            #size-cells = <0>;

            led@4,0 {
                reg = <4 0>;
                function = "lan";
            };

            led@4,1 {
                reg = <4 1>;
                function = "wlan";
            };
        };
    };
  - |
    display_client: spi {
        #address-cells = <1>;
        #size-cells = <0>;

        display@0 {
            compatible = "titanmec,tm1628";
            reg = <0>;
            tm16xx,transposed;
            tm16xx,digits = /bits/ 8 <1 2 3 4>;
            tm16xx,segment-mapping = /bits/ 8 <0 1 2 3 4 5 6>;

            #address-cells = <2>;
            #size-cells = <0>;

            led@0,2 {
                reg = <0 2>;
                function = "usb";
            };

            led@0,3 {
                reg = <0 3>;
                function = "power";
            };
        };
    };
```

## Documentation/devicetree/bindings/media/amlogic,vcodec-dec.yaml
```yaml
# SPDX-License-Identifier: (GPL-2.0-only OR BSD-2-Clause)
# Copyright (C) 2025 Amlogic, Inc. All rights reserved
%YAML 1.2
---
$id: http://devicetree.org/schemas/media/amlogic,vcodec-dec.yaml#
$schema: http://devicetree.org/meta-schemas/core.yaml#

title: Amlogic Video Decode Accelerator

maintainers:
  - Zhentao Guo <zhentao.guo@amlogic.com>

description: |
  The Video Decoder Accelerator present on Amlogic SOCs.
  It supports stateless h264 decoding.

properties:
  compatible:
    const: amlogic,s4-vcodec-dec

  reg:
    maxItems: 2

  reg-names:
    items:
      - const: dosbus
      - const: dmcbus

  interrupts:
    maxItems: 3

  interrupt-names:
    items:
      - const: mailbox_0
      - const: mailbox_1
      - const: mailbox_2

  clocks:
    maxItems: 3

  clock-names:
    items:
      - const: vdec
      - const: clk_vdec_mux
      - const: clk_hevcf_mux

  power-domains:
    maxItems: 2

  power-domain-names:
    items:
      - const: pwrc-vdec
      - const: pwrc-hevc

required:
  - compatible
  - reg
  - reg-names
  - interrupts
  - interrupt-names
  - clocks
  - clock-names
  - power-domains
  - power-domain-names

additionalProperties: false

examples:
  - |
    #include <dt-bindings/interrupt-controller/arm-gic.h>
    #include <dt-bindings/clock/amlogic,s4-pll-clkc.h>
    #include <dt-bindings/clock/amlogic,s4-peripherals-clkc.h>
    #include <dt-bindings/power/meson-s4-power.h>
    video-codec@fe320000 {
      compatible = "amlogic,s4-vcodec-dec";
      reg = <0xfe320000 0x10000>,
            <0xfe036000 0x2000>;
      reg-names = "dosbus",
                  "dmcbus";
      interrupts = <GIC_SPI 91 IRQ_TYPE_EDGE_RISING>,
                   <GIC_SPI 92 IRQ_TYPE_EDGE_RISING>,
                   <GIC_SPI 93 IRQ_TYPE_EDGE_RISING>;
      interrupt-names = "mailbox_0",
                        "mailbox_1",
                        "mailbox_2";
      clocks = <&clkc_periphs CLKID_DOS>,
               <&clkc_periphs CLKID_VDEC_SEL>,
               <&clkc_periphs CLKID_HEVCF_SEL>;
      clock-names = "vdec",
                    "clk_vdec_mux",
                    "clk_hevcf_mux";
      power-domains = <&pwrc PWRC_S4_DOS_VDEC_ID>,
                      <&pwrc PWRC_S4_DOS_HEVC_ID>;
      power-domain-names = "pwrc-vdec",
                           "pwrc-hevc";
    };
```

## Documentation/devicetree/bindings/media/rockchip,rk3588-iep2.yaml
```yaml
# SPDX-License-Identifier: (GPL-2.0 OR BSD-2-Clause)
%YAML 1.2
---
$id: http://devicetree.org/schemas/media/rockchip,rk3588-iep2.yaml#
$schema: http://devicetree.org/meta-schemas/core.yaml#

title: Rockchip Image Enhancement Processor v2 (IEP2)

description:
    The Rockchip IEP2 is a second-generation image enhancement processor
    that supports hardware-accelerated YUV deinterlacing with motion
    detection, motion estimation, and edge-directed interpolation.

maintainers:
  - Heiko Stuebner <heiko@sntech.de>

properties:
  compatible:
    enum:
      - rockchip,rk3576-iep2
      - rockchip,rk3588-iep2

  reg:
    maxItems: 1

  interrupts:
    maxItems: 1

  clocks:
    maxItems: 3

  clock-names:
    items:
      - const: aclk
      - const: hclk
      - const: sclk

  power-domains:
    maxItems: 1

  iommus:
    maxItems: 1

  resets:
    maxItems: 3

  reset-names:
    items:
      - const: axi
      - const: ahb
      - const: core

required:
  - compatible
  - reg
  - interrupts
  - clocks
  - clock-names

additionalProperties: false

examples:
  - |
    #include <dt-bindings/clock/rockchip,rk3588-cru.h>
    #include <dt-bindings/interrupt-controller/arm-gic.h>
    #include <dt-bindings/power/rk3588-power.h>
    #include <dt-bindings/reset/rockchip,rk3588-cru.h>

    iep2: iep@fdbb0000 {
      compatible = "rockchip,rk3588-iep2";
      reg = <0xfdbb0000 0x500>;
      interrupts = <GIC_SPI 117 IRQ_TYPE_LEVEL_HIGH>;
      clocks = <&cru ACLK_IEP2P0>, <&cru HCLK_IEP2P0>,
               <&cru CLK_IEP2P0_CORE>;
      clock-names = "aclk", "hclk", "sclk";
      power-domains = <&power RK3588_PD_VDPU>;
      resets = <&cru SRST_A_IEP2P0>, <&cru SRST_H_IEP2P0>,
               <&cru SRST_IEP2P0_CORE>;
      reset-names = "axi", "ahb", "core";
    };
```

## Documentation/devicetree/bindings/media/rockchip-iep.yaml
```yaml
# SPDX-License-Identifier: (GPL-2.0 OR BSD-2-Clause)
%YAML 1.2
---
$id: http://devicetree.org/schemas/media/rockchip-iep.yaml#
$schema: http://devicetree.org/meta-schemas/core.yaml#

title: Rockchip Image Enhancement Processor (IEP)

description:
    Rockchip IEP supports image enhancement operations for YUV and RGB
    domains. The YUV block supports deinterlacing, spatial and temporal
    sampling noise reduction. The RGB block supports Gamma adjustment,
    edge enhancement, and detail enhancement. Both YUV and RGB blocks
    support Brightness, Saturation, Contrast, and Hue adjustment. IEP
    also supports RGB-to-YUV and YUV-to-RGB conversion.

maintainers:
  - Heiko Stuebner <heiko@sntech.de>

properties:
  compatible:
    oneOf:
      - const: rockchip,rk3228-iep
      - items:
          - enum:
              - rockchip,rk3288-iep
              - rockchip,rk3328-iep
              - rockchip,rk3368-iep
              - rockchip,rk3399-iep
          - const: rockchip,rk3228-iep

  reg:
    maxItems: 1

  interrupts:
    maxItems: 1

  clocks:
    maxItems: 2

  clock-names:
    items:
      - const: axi
      - const: ahb

  power-domains:
    maxItems: 1

  iommus:
    maxItems: 1

required:
  - compatible
  - reg
  - interrupts
  - clocks
  - clock-names

additionalProperties: false

examples:
  - |
    #include <dt-bindings/clock/rk3228-cru.h>
    #include <dt-bindings/interrupt-controller/arm-gic.h>
    #include <dt-bindings/power/rk3228-power.h>
    iep: iep@20070000 {
      compatible = "rockchip,rk3228-iep";
      reg = <0x20070000 0x800>;
      interrupts = <GIC_SPI 31 IRQ_TYPE_LEVEL_HIGH>;
      clocks = <&cru ACLK_IEP>, <&cru HCLK_IEP>;
      clock-names = "axi", "ahb";
      iommus = <&iep_mmu>;
      power-domains = <&power RK3228_PD_VIO>;
    };
```

## drivers/media/platform/amlogic/vdec/Kconfig
```kconfig
# SPDX-License-Identifier: (GPL-2.0-only OR MIT)

config VIDEO_AMLOGIC_VDEC
    tristate "Amlogic Video Decoder Driver"
    depends on ARCH_MESON || COMPILE_TEST
    depends on VIDEO_DEV
    depends on V4L_MEM2MEM_DRIVERS
    select VIDEOBUF2_DMA_CONTIG
    select V4L2_H264
    select V4L2_MEM2MEM_DEV
    select MESON_CANVAS
    help
      This is a v4l2 driver for Amlogic video decoder driver.
	  This driver is designed to support V4L2 M2M STATELESS
	  interface.
      To compile this driver as a module choose m here.
```

## drivers/media/platform/rockchip/iep2/Kconfig
```kconfig
# SPDX-License-Identifier: GPL-2.0-only
config VIDEO_ROCKCHIP_IEP2
	tristate "Rockchip Image Enhancement Processor v2"
	depends on V4L_MEM2MEM_DRIVERS
	depends on VIDEO_DEV
	depends on ARCH_ROCKCHIP || COMPILE_TEST
	select VIDEOBUF2_DMA_CONTIG
	select V4L2_MEM2MEM_DEV
	help
	  Support for the Rockchip IEP2, a hardware video deinterlacer
	  with motion detection, motion estimation, and edge-directed
	  interpolation. Found on RK3588 and similar SoCs.

	  To compile this driver as a module, choose M here: the module
	  will be called rockchip-iep2.
```
