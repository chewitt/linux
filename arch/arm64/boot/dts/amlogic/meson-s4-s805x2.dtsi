// SPDX-License-Identifier: (GPL-2.0+ OR MIT)
/*
 * Copyright (c) 2026 Christian Hewitt <christianshewitt@gmail.com>
 */

#include "meson-s4.dtsi"

&cpu_opp_table {
	opp-1800000000 {
		opp-hz = /bits/ 64 <1800000000>;
		opp-microvolt = <1009000>;
	};
};
