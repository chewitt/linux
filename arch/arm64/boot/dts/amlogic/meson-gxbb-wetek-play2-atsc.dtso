// SPDX-License-Identifier: (GPL-2.0+ OR MIT)
/*
 * WeTek Play 2 ATSC frontend overlay
 * Demod: Panasonic MN88436 + Tuner: MxL603
 */

/dts-v1/;
/plugin/;

#include <dt-bindings/gpio/gpio.h>
#include <dt-bindings/gpio/meson-gxbb-gpio.h>

&dvb_demux {
	atsc: frontend@0 {
		compatible = "wetek,atsc";
		i2c-bus = <&i2c_A>;
		fec-reset-gpios = <&gpio GPIOY_13 GPIO_ACTIVE_HIGH>;
		power-ctrl-gpios = <&gpio GPIOY_15 GPIO_ACTIVE_HIGH>;
	};
};
