// SPDX-License-Identifier: (GPL-2.0+ OR MIT)
/*
 * WeTek Play 2 DVB-S/S2 frontend overlay
 * Demod + Tuner: Availink AVL6211 + AV2011
 */

/dts-v1/;
/plugin/;

#include <dt-bindings/gpio/gpio.h>
#include <dt-bindings/gpio/meson-gxbb-gpio.h>

&dvb_demux {
	dvb_s: frontend@0 {
		compatible = "wetek,dvb-s";
		i2c-bus = <&i2c_A>;
		fec-reset-gpios = <&gpio GPIOY_13 GPIO_ACTIVE_HIGH>;
		power-ctrl-gpios = <&gpio GPIOY_15 GPIO_ACTIVE_HIGH>;
	};
};
